## boards/shields/lilium/Kconfig.defconfig
```kconfig
if SHIELD_LILIUM_LEFT

config ZMK_KEYBOARD_NAME
    default "LiLium"

config ZMK_SPLIT_BLE_ROLE_CENTRAL
    default y

endif

if SHIELD_LILIUM_LEFT || SHIELD_LILIUM_RIGHT

config ZMK_SPLIT
    default y

endif
```

## boards/shields/lilium/Kconfig.shield
```kconfig
config SHIELD_LILIUM_LEFT
    def_bool $(shields_list_contains,lilium_left)

config SHIELD_LILIUM_RIGHT
    def_bool $(shields_list_contains,lilium_right)
```
